## conf/bblayers.conf.sample
```bitbake
# POKY_BBLAYERS_CONF_VERSION is increased each time build/conf/bblayers.conf
# changes incompatibly
POKY_BBLAYERS_CONF_VERSION = "2"

BBPATH = "${TOPDIR}"
BBFILES ?= ""

OEROOT := "##OEROOT##"
BBLAYERS  ?= " \
  ${OEROOT}/../meta-medusa-backport \
  ${OEROOT}/meta \
  ${OEROOT}/meta-poky \
  ${OEROOT}/meta-yocto-bsp \
  ${OEROOT}/../meta-openembedded/meta-oe \
  ${OEROOT}/../meta-openembedded/meta-python \
  ${OEROOT}/../meta-openembedded/meta-networking \
  ${OEROOT}/../meta-openembedded/meta-filesystems \
  ${OEROOT}/../meta-qt5 \
  ${OEROOT}/../meta-phytec \
  ${OEROOT}/../meta-medusa-bsp \
  ${OEROOT}/../meta-medusa-dist \
  ${OEROOT}/../meta-medusa-app \
  "
```

## conf/distro/medusa.conf
```bitbake
INHERIT += "medusa-version"
BB_HASHCONFIG_WHITELIST += "MEDUSA_METADATA_VERSION MEDUSA_METADATA_GIT_DATE_TIME MEDUSA_METADATA_GIT_HASH_SHORT MEDUSA_METADATA_GIT_STATUS"

# Distro naming
DISTRO = "medusa"
DISTRO_NAME = "Stromer Medusa Distribution"
DISTRO_VERSION = "${MEDUSA_METADATA_GIT_DATE_TIME}-${MEDUSA_METADATA_GIT_HASH_SHORT}${MEDUSA_METADATA_GIT_STATUS}"

# Image naming
IMAGE_LINK_NAME = "${IMAGE_BASENAME}"
IMAGE_NAME = "${IMAGE_BASENAME}-${MEDUSA_METADATA_VERSION}-${MEDUSA_METADATA_GIT_DATE_TIME}-${MEDUSA_METADATA_GIT_HASH_SHORT}${MEDUSA_METADATA_GIT_STATUS}"

# SDK naming
SDK_NAME = "${DISTRO}-${SDK_ARCH}"
SDK_VERSION = "${MEDUSA_METADATA_GIT_DATE_TIME}-${MEDUSA_METADATA_GIT_HASH_SHORT}${MEDUSA_METADATA_GIT_STATUS}"
SDKPATH = "/opt/${DISTRO}/${MEDUSA_METADATA_GIT_DATE_TIME}-${MEDUSA_METADATA_GIT_HASH_SHORT}${MEDUSA_METADATA_GIT_STATUS}"

# Distro features
DISTRO_FEATURES = "systemd"

# Machine features
MACHINE_FEATURES_append = " 3g alsa can bluetooth usbgadget usbhost"

# Virtual runtime settings
VIRTUAL-RUNTIME_dev_manager = "udev"
VIRTUAL-RUNTIME_init_manager = "systemd"
DISTRO_FEATURES_BACKFILL_CONSIDERED += "sysvinit"
VIRTUAL-RUNTIME_login_manager = "busybox"
VIRTUAL-RUNTIME_syslog = ""
VIRTUAL-RUNTIME_initscripts = ""

# systemd settings
SYSTEMD_DEFAULT_TARGET = "graphical.target"
BAD_RECOMMENDATIONS += "systemd-extra-utils udev-hwdb"

# Image appends
IMAGE_INSTALL_append = " medusa-apps medusa-services"
IMAGE_INSTALL_append = " bluez5 ppp wvdial"
IMAGE_INSTALL_append = " gnupg pristine-tar-fwu xdelta3"
IMAGE_INSTALL_append = " gtest"
IMAGE_INSTALL_append = " tcf-agent"
IMAGE_INSTALL_append = " openssh openssh-sftp-server"
IMAGE_INSTALL_append = " alsa-utils busybox can-utils htop nano python rsync tree"
IMAGE_INSTALL_append = " alsa-lib"

# Uncomment this to save some space
#PACKAGECONFIG_DEFAULT_remove_pn-qtbase = " dbus"

# Uncomment this to install systemd-analyze.
#IMAGE_INSTALL_append = " systemd-analyze"

# Uncomment this to install qt exmaples.
#PACKAGECONFIG_append_pn-qtbase = " examples"
#IMAGE_INSTALL_append = " qtbase-examples"

# Do not install any locales
IMAGE_LINGUAS = ""

# Activate config checker
INHERIT += "sanity"

# Run QA tests on recipes
INHERIT += "recipe_sanity"

# Run QA tests on builds and packages and log them
INHERIT += "insane"
QA_LOG = "1"

# Log information on images and packages
INHERIT += "buildhistory"
BUILDHISTORY_COMMIT = "1"
INHERIT += "buildstats"
```

## conf/layer.conf
```bitbake
# We have a conf and classes directory, add to BBPATH
BBPATH .= ":${LAYERDIR}"

# We have recipes-* directories, add to BBFILES
BBFILES += "${LAYERDIR}/recipes-*/*/*.bb \
            ${LAYERDIR}/recipes-*/*/*.bbappend"

BBFILE_COLLECTIONS += "medusa-dist"
BBFILE_PATTERN_medusa-dist = "^${LAYERDIR}/"
BBFILE_PRIORITY_medusa-dist = "40"

LAYERSERIES_COMPAT_medusa-dist = "scarthgap"

# Additional license directories.
LICENSE_PATH += "${LAYERDIR}/licenses"

# Layer dependencies
LAYERDEPENDS_medusa-dist = "phytec medusa-bsp"

# Keep BSP-Yocto-Ampliphy-i.MX6UL-PD22.1.1 (barebox & linux-mainline) for now
# but use it with scarthgap layers as BSP-Yocto-Ampliphy-i.MX6UL-PD24.1.0
LAYERSERIES_COMPAT_phytec = "kirkstone scarthgap"
```
